## boards/shields/divide/Kconfig.defconfig
```kconfig
if SHIELD_DIVIDE_LEFT

config ZMK_KEYBOARD_NAME
    default "Divide"

config ZMK_SPLIT_ROLE_CENTRAL
    default y

endif # SHIELD_DIVIDE_LEFT

if SHIELD_DIVIDE_LEFT || SHIELD_DIVIDE_RIGHT

config ZMK_SPLIT
    default y

endif # SHIELD_DIVIDE_LEFT || SHIELD_DIVIDE_RIGHT
```

## boards/shields/divide/Kconfig.shield
```kconfig
config SHIELD_DIVIDE
    bool

config SHIELD_DIVIDE_LEFT
    bool
    default $(shields_list_contains,divide_left)
    select SHIELD_DIVIDE

config SHIELD_DIVIDE_RIGHT
    bool
    default $(shields_list_contains,divide_right)
    select SHIELD_DIVIDE

config SHIELD_DIVIDE_DONGLE
    bool
    default $(shields_list_contains,divide_dongle)
    select SHIELD_DIVIDE
```
